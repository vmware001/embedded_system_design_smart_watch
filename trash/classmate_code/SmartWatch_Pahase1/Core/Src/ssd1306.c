#include "ssd1306.h"

/* ---- 显存缓冲 (128×64 = 8页×128列) ---- */
static uint8_t framebuffer[1024];

/* ---- 光标 ---- */
static uint8_t cursor_x = 0;
static uint8_t cursor_page = 0;

/* ---- 6x8 点阵字库 (ASCII 32~126) ---- */
static const uint8_t Font_6x8[][6] = {
    {0x00,0x00,0x00,0x00,0x00,0x00}, // (32) ' '
    {0x00,0x00,0x5F,0x00,0x00,0x00}, // (33) '!'
    {0x00,0x07,0x00,0x07,0x00,0x00}, // (34) '"'
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    {0x08,0x08,0x2A,0x1C,0x08,0x00}, // (126) '~'
};

/* ======== 底层 I2C 收发 ======== */

void SSD1306_WriteCommand(uint8_t command) {
    while (HAL_I2C_GetState(&hi2c1) != HAL_I2C_STATE_READY);
    HAL_I2C_Mem_Write(&hi2c1, SSD1306_I2C_ADDR, 0x00, I2C_MEMADD_SIZE_8BIT, &command, 1, HAL_MAX_DELAY);
}

void SSD1306_WriteData(uint8_t* data, uint16_t size) {
    while (HAL_I2C_GetState(&hi2c1) != HAL_I2C_STATE_READY);
    HAL_I2C_Mem_Write(&hi2c1, SSD1306_I2C_ADDR, 0x40, I2C_MEMADD_SIZE_8BIT, data, size, HAL_MAX_DELAY);
}

/* ======== 初始化 ======== */

void SSD1306_Init(void) {
    HAL_Delay(100);

    SSD1306_WriteCommand(0xAE); // 关闭显示
    SSD1306_WriteCommand(0x20); // 设置寻址模式
    SSD1306_WriteCommand(0x00); // 水平寻址模式 (便于整屏刷写)
    SSD1306_WriteCommand(0x21); // 设置列地址范围
    SSD1306_WriteCommand(0x00); // 起始列 0
    SSD1306_WriteCommand(0x7F); // 结束列 127
    SSD1306_WriteCommand(0x22); // 设置页地址范围
    SSD1306_WriteCommand(0x00); // 起始页 0
    SSD1306_WriteCommand(0x07); // 结束页 7
    SSD1306_WriteCommand(0xA1); // 左右翻转映射
    SSD1306_WriteCommand(0xC8); // 上下翻转扫描
    SSD1306_WriteCommand(0xDA); // COM引脚配置
    SSD1306_WriteCommand(0x12); // 128x64面板适配
    SSD1306_WriteCommand(0x81); // 对比度
    SSD1306_WriteCommand(0xFF); // 亮度最大
    SSD1306_WriteCommand(0xA6); // 正常显示
    SSD1306_WriteCommand(0xA8); // 复用率
    SSD1306_WriteCommand(0x3F); // 64行
    SSD1306_WriteCommand(0xD3); // 显示偏移
    SSD1306_WriteCommand(0x00);
    SSD1306_WriteCommand(0x40); // 起始行
    SSD1306_WriteCommand(0xD5); // 时钟分频
    SSD1306_WriteCommand(0x80);
    SSD1306_WriteCommand(0x8D); // 电荷泵
    SSD1306_WriteCommand(0x14); // 开启电荷泵
    SSD1306_WriteCommand(0x2E); // 禁用滚动
    SSD1306_WriteCommand(0xAF); // 开启显示
    HAL_Delay(50);

    /* 清空显存 */
    SSD1306_Clear();
    SSD1306_Flush();
}

/* ======== 全屏点亮（硬件测试用） ======== */

void SSD1306_FillAll(void) {
    for (int i = 0; i < 1024; i++) framebuffer[i] = 0xFF;
    SSD1306_Flush();
}

/* ======== 清屏 (仅清显存缓冲) ======== */

void SSD1306_Clear(void) {
    for (int i = 0; i < 1024; i++) framebuffer[i] = 0x00;
    cursor_x = 0;
    cursor_page = 0;
}

/* ======== 将显存一次性刷到屏幕 ======== */

void SSD1306_Flush(void) {
    while (HAL_I2C_GetState(&hi2c1) != HAL_I2C_STATE_READY);
    HAL_I2C_Mem_Write(&hi2c1, SSD1306_I2C_ADDR, 0x40, I2C_MEMADD_SIZE_8BIT,
                      framebuffer, 1024, HAL_MAX_DELAY);
}

/* ======== 设置光标位置 ======== */

void SSD1306_SetCursor(uint8_t x, uint8_t page) {
    if (x > 127) x = 127;
    if (page > 7) page = 7;
    cursor_x = x;
    cursor_page = page;
}

/* ======== 写入单个字符 (写入显存缓冲) ======== */

void SSD1306_WriteChar(char ch) {
    if (ch < 32 || ch > 126) ch = ' ';
    uint8_t idx = ch - 32;

    /* 将 6 列点阵写入显存 */
    for (uint8_t i = 0; i < 6; i++) {
        if (cursor_x + i < 128) {
            framebuffer[cursor_page * 128 + cursor_x + i] = Font_6x8[idx][i];
        }
    }

    /* 光标右移 6 像素 */
    cursor_x += 6;
    if (cursor_x > 122) {
        cursor_x = 0;
        if (cursor_page < 7) cursor_page++;
    }
}

/* ======== 写入字符串 ======== */

void SSD1306_WriteString(char *str) {
    while (*str) {
        SSD1306_WriteChar(*str);
        str++;
    }
}

/* ======== 设置单个像素 (内部辅助) ======== */
static void fb_set_pixel(uint8_t x, uint8_t y)
{
    if (x >= 128 || y >= 64) return;
    framebuffer[(y / 8) * 128 + x] |= (1UL << (y % 8));
}

/* ======== 绘制缩放字符: (x,y) 像素坐标, sx/sy 为横纵缩放倍数 ======== */
void SSD1306_DrawBigChar(char ch, uint8_t x, uint8_t y, uint8_t sx, uint8_t sy)
{
    if (ch < 32 || ch > 126) ch = ' ';
    uint8_t idx = ch - 32;

    for (uint8_t c = 0; c < 6; c++) {
        uint8_t col = Font_6x8[idx][c];
        for (uint8_t r = 0; r < 8; r++) {
            if (col & (1UL << r)) {
                for (uint8_t dx = 0; dx < sx; dx++) {
                    for (uint8_t dy = 0; dy < sy; dy++) {
                        fb_set_pixel(x + c * sx + dx, y + r * sy + dy);
                    }
                }
            }
        }
    }
}

/* ======== 绘制空心矩形 ======== */
void SSD1306_DrawRect(uint8_t x, uint8_t y, uint8_t w, uint8_t h)
{
    uint8_t i;
    /* 上下边 */
    for (i = 0; i < w; i++) {
        fb_set_pixel(x + i, y);
        if (h > 1) fb_set_pixel(x + i, y + h - 1);
    }
    /* 左右边 */
    for (i = 1; i < h - 1; i++) {
        fb_set_pixel(x, y + i);
        if (w > 1) fb_set_pixel(x + w - 1, y + i);
    }
}

/* ======== 16x16 中文字库 (14个汉字, 每字32字节, 列优先) ======== */
/* 字符顺序: 春嵌入式课设刘缘园王昊柳政道 */
static const uint8_t CN_Font16[14][32] = {
    /* 春 */ { 0x40, 0x04, 0x44, 0x04, 0x54, 0x06, 0x54, 0x03, 0xD4, 0xFF, 0xD4, 0xFE, 0x74, 0x92, 0x7F, 0x92, 0x5F, 0x92, 0x54, 0x92, 0xD4, 0xFE, 0xD4, 0xFF, 0x54, 0x03, 0x54, 0x06, 0x44, 0x04, 0x40, 0x04 },
    /* 嵌 */ { 0x80, 0x00, 0x80, 0x00, 0xEE, 0x7F, 0xEE, 0x7F, 0x88, 0x24, 0x88, 0x24, 0xE8, 0x7F, 0xEF, 0x7F, 0x8F, 0x81, 0x88, 0xC1, 0xF8, 0x70, 0x78, 0x3F, 0x4E, 0x3F, 0x4E, 0x71, 0xC0, 0xC1, 0xC0, 0x80 },
    /* 入 */ { 0x00, 0x80, 0x00, 0xC0, 0x00, 0x60, 0x00, 0x30, 0x00, 0x1C, 0x01, 0x0F, 0xE3, 0x03, 0xFE, 0x00, 0xFC, 0x00, 0xE0, 0x03, 0x00, 0x0F, 0x00, 0x3C, 0x00, 0x70, 0x00, 0xC0, 0x00, 0x80, 0x00, 0x80 },
    /* 式 */ { 0x10, 0x00, 0x10, 0x20, 0x90, 0x60, 0x90, 0x60, 0x90, 0x3F, 0x90, 0x3F, 0x90, 0x10, 0x90, 0x10, 0x10, 0x10, 0xFF, 0x03, 0xFF, 0x0F, 0x10, 0x1C, 0x11, 0x30, 0x17, 0x60, 0x16, 0xF8, 0x10, 0xF8 },
    /* 课 */ { 0x40, 0x00, 0x42, 0x00, 0xCE, 0x3F, 0xCC, 0x3F, 0x00, 0x18, 0x00, 0x2A, 0xFE, 0x32, 0xFE, 0x1A, 0x92, 0x0E, 0xFE, 0xFF, 0xFE, 0xFF, 0x92, 0x0E, 0xFE, 0x1A, 0xFE, 0x32, 0x00, 0x22, 0x00, 0x20 },
    /* 设 */ { 0x40, 0x00, 0x40, 0x00, 0x42, 0x00, 0xCE, 0x3F, 0xCC, 0xBF, 0x40, 0x98, 0xE0, 0xC8, 0xBE, 0x43, 0x9E, 0x6F, 0x82, 0x3C, 0x82, 0x38, 0x9E, 0x6E, 0xBE, 0x47, 0xA0, 0xC1, 0x20, 0x80, 0x20, 0x80 },
    /* 刘 */ { 0x08, 0x40, 0x28, 0x60, 0x68, 0x30, 0xC9, 0x19, 0x8F, 0x0F, 0x8E, 0x1F, 0xF8, 0x79, 0x78, 0x60, 0x08, 0x00, 0x08, 0x00, 0xF8, 0x0F, 0xF8, 0x4F, 0x00, 0xC0, 0xFF, 0xFF, 0xFF, 0x7F, 0x00, 0x00 },
    /* 缘 */ { 0x20, 0x22, 0x30, 0x67, 0xBC, 0x67, 0xEF, 0x32, 0x73, 0x12, 0x30, 0x12, 0x20, 0x49, 0x2C, 0x49, 0xAF, 0x6D, 0xEB, 0x76, 0xEA, 0xDB, 0xAA, 0xFF, 0x3A, 0x7F, 0x3E, 0x0F, 0xA6, 0x1D, 0xA0, 0x10 },
    /* 园 */ { 0x00, 0x00, 0xFE, 0xFF, 0xFE, 0xFF, 0x42, 0x50, 0x4A, 0x5C, 0xCA, 0x4F, 0xCA, 0x43, 0x4A, 0x40, 0xCA, 0x4F, 0xCA, 0x5F, 0x4A, 0x50, 0x4A, 0x5C, 0x42, 0x5C, 0xFE, 0xFF, 0xFE, 0xFF, 0x00, 0x00 },
    /* 王 */ { 0x00, 0x40, 0x02, 0x40, 0x82, 0x40, 0x82, 0x40, 0x82, 0x40, 0x82, 0x40, 0x82, 0x40, 0xFE, 0x7F, 0xFE, 0x7F, 0x82, 0x40, 0x82, 0x40, 0x82, 0x40, 0x82, 0x40, 0x82, 0x40, 0x02, 0x40, 0x00, 0x40 },
    /* 昊 */ { 0x00, 0x88, 0x00, 0x88, 0x00, 0x89, 0x3E, 0xC9, 0x3E, 0x49, 0x2A, 0x69, 0x2A, 0x39, 0x2A, 0x1F, 0x2A, 0x1F, 0x2A, 0x39, 0x2A, 0x69, 0x3E, 0x49, 0x3E, 0xC9, 0x00, 0x89, 0x00, 0x88, 0x00, 0x88 },
    /* 柳 */ { 0x10, 0x04, 0x10, 0x07, 0xD0, 0x03, 0xFF, 0xFF, 0xFF, 0xFF, 0x90, 0x01, 0xFC, 0x8F, 0xFC, 0xCF, 0x06, 0x76, 0xFA, 0x3F, 0xF8, 0x0F, 0xFC, 0xFF, 0xFC, 0xFF, 0x04, 0x0C, 0xFC, 0x0F, 0xFC, 0x07 },
    /* 政 */ { 0x04, 0x20, 0xC4, 0x3F, 0xC4, 0x3F, 0x04, 0x20, 0xFC, 0x3F, 0xFC, 0x1F, 0x84, 0x10, 0x84, 0x90, 0x84, 0xD0, 0xF0, 0x60, 0xFF, 0x33, 0x8F, 0x1F, 0x08, 0x3F, 0xF8, 0x73, 0xF8, 0xC0, 0x08, 0x80 },
    /* 道 */ { 0x40, 0x00, 0x40, 0x40, 0x42, 0x60, 0xCE, 0x3F, 0xCC, 0x3F, 0x08, 0x60, 0xE9, 0x5F, 0xEB, 0x5F, 0xBA, 0x4A, 0xB8, 0x4A, 0xA8, 0x4A, 0xAA, 0x4A, 0xEB, 0x5F, 0xE9, 0x5F, 0x08, 0x40, 0x00, 0x40 },
};

/* UTF-8 查找表: 与 CN_Font16 顺序一一对应, 每个汉字3字节 */
static const char CN_Lookup[] = "春嵌入式课设刘缘园王昊柳政道";

/* ======== 在查找表中定位汉字, 返回索引, 未找到返回 -1 ======== */
static int CN_LookupIndex(const uint8_t *utf8)
{
    uint8_t i;
    for (i = 0; i < sizeof(CN_Lookup) - 1; i += 3) {
        if (utf8[0] == (uint8_t)CN_Lookup[i] &&
            utf8[1] == (uint8_t)CN_Lookup[i + 1] &&
            utf8[2] == (uint8_t)CN_Lookup[i + 2]) {
            return i / 3;
        }
    }
    return -1;
}

/* ======== 绘制中文字符串 (UTF-8), 像素坐标, spacing=水平步进 ======== */
void SSD1306_DrawCNStr(const char *str, uint8_t x, uint8_t y, uint8_t spacing)
{
    uint8_t cx = x;
    const char *p = str;

    while (*p) {
        uint8_t b = (uint8_t)*p;
        /* CJK 字符: UTF-8 首字节 0xE0~0xEF */
        if (b >= 0xE0 && b <= 0xEF && *(p + 1) && *(p + 2)) {
            int idx = CN_LookupIndex((const uint8_t *)p);
            if (idx >= 0) {
                uint8_t col, row;
                const uint8_t *font = CN_Font16[idx];
                for (col = 0; col < 16; col++) {
                    uint8_t d0 = font[col * 2];
                    uint8_t d1 = font[col * 2 + 1];
                    for (row = 0; row < 8; row++) {
                        if (d0 & (1 << row))
                            fb_set_pixel(cx + col, y + row);
                        if (d1 & (1 << row))
                            fb_set_pixel(cx + col, y + 8 + row);
                    }
                }
                cx += spacing;
            }
            p += 3;
        } else {
            p++;
        }
    }
}

