/*
 * ssd1306.c
 *
 *  Created on: 2026年7月3日
 *      Author: Whisper
 */

#include "ssd1306.h"
#include "i2c.h"        // 根据实际工程修改，包含 HAL_I2C 头文件
#include <string.h>
#include "cmsis_os.h"

/* ============================================================
 *  底层 I2C 接口配置
 * ============================================================ */

// 外部声明 I2C 句柄（根据实际使用的 I2C 接口修改，如 hi2c2）
extern I2C_HandleTypeDef hi2c1;

// SSD1306 的 I2C 写地址 = 0x3C << 1 = 0x78
#define SSD1306_I2C_ADDR    (SSD1306_ADDR << 1)

// 控制字节定义
#define SSD1306_CTRL_CMD    0x00    // Co=0, D/C#=0: 后续为命令
#define SSD1306_CTRL_DATA   0x40    // Co=0, D/C#=1: 后续为数据

/**
 * @brief 向 SSD1306 发送控制字节 + 负载（命令或数据）
 * @param ctrl 控制字节：0x00 表示命令，0x40 表示数据
 * @param payload 实际发送的字节
 */
// 引用 freertos.c 创建的互斥锁句柄
extern osMutexId mutexI2CHandle;

static void SSD1306_SendByte(uint8_t ctrl, uint8_t payload)
{
    uint8_t buf[2] = {ctrl, payload};

    osMutexWait(mutexI2CHandle, osWaitForever);

    HAL_I2C_Master_Transmit(&hi2c1, SSD1306_I2C_ADDR, buf, 2, HAL_MAX_DELAY);

    osMutexRelease(mutexI2CHandle);
}

/**
 * @brief 发送单条命令
 */
static void SSD1306_WriteCommand(uint8_t cmd)
{
    SSD1306_SendByte(SSD1306_CTRL_CMD, cmd);
}

/**
 * @brief 发送单个数据字节
 */
static void SSD1306_WriteData(uint8_t data)
{
    SSD1306_SendByte(SSD1306_CTRL_DATA, data);
}

/* ============================================================
 *  5x7 ASCII 字库 (6x8 实际显示，含 1 列间隔)
 *  支持字符范围: 空格(0x20) ~ 波浪号(0x7E)
 * ============================================================ */
static const uint8_t Font5x7[][5] = {
    {0x00,0x00,0x00,0x00,0x00}, // 空格 ' '
    {0x00,0x00,0x5F,0x00,0x00}, // !
    {0x00,0x07,0x00,0x07,0x00}, // "
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    {0x08,0x08,0x2A,0x1C,0x08}, // ~
};

/* ============================================================
 *  用户接口函数实现
 * ============================================================ */

/**
 * @brief SSD1306 初始化
 * @note  严格按手册顺序发送初始化序列
 */
void SSD1306_Init(void)
{
    // 等待 OLED 上电稳定（至少 100ms）
    HAL_Delay(100);

    // 1. 显示关闭
    SSD1306_WriteCommand(0xAE);

    // 2. 时钟分频 / 振荡频率
    SSD1306_WriteCommand(0xD5);
    SSD1306_WriteCommand(0x80); // 默认值：分频比=1，振荡频率≈370kHz

    // 3. 多路复用率 (MUX)
    SSD1306_WriteCommand(0xA8);
    SSD1306_WriteCommand(0x3F); // 0x3F = 64MUX (适用于 128x64)

    // 4. 显示偏移
    SSD1306_WriteCommand(0xD3);
    SSD1306_WriteCommand(0x00); // 无偏移

    // 5. 启动行
    SSD1306_WriteCommand(0x40 | 0x00); // 从第 0 行开始

    // 6. 电荷泵设置
    SSD1306_WriteCommand(0x8D);
    SSD1306_WriteCommand(0x14); // 0x14=开启电荷泵，0x10=关闭

    // 7. 内存寻址模式
    SSD1306_WriteCommand(0x20);
    SSD1306_WriteCommand(0x02); // 0x02=页寻址模式（最常用）

    // 8. 段重映射 (左右反置)
    SSD1306_WriteCommand(0xA1); // 0xA1=重映射（从左到右），0xA0=正常

    // 9. COM 扫描方向 (上下反置)
    SSD1306_WriteCommand(0xC8); // 0xC8=从下到上扫描，0xC0=从上到下

    // 10. COM 引脚配置
    SSD1306_WriteCommand(0xDA);
    SSD1306_WriteCommand(0x12); // 0x12=交替 COM，禁用重映射（适用于 128x64）

    // 11. 对比度
    SSD1306_WriteCommand(0x81);
    SSD1306_WriteCommand(0xCF); // 亮度较高

    // 12. 预充电周期
    SSD1306_WriteCommand(0xD9);
    SSD1306_WriteCommand(0xF1); // 预充电=15，放电=1

    // 13. VCOMH 去耦电平
    SSD1306_WriteCommand(0xDB);
    SSD1306_WriteCommand(0x40); // ~0.77x Vcc

    // 14. 全屏显示（正常显示，非全屏点亮）
    SSD1306_WriteCommand(0xA4); // 0xA4=正常显示，0xA5=全屏点亮

    // 15. 反色（正常显示，非反色）
    SSD1306_WriteCommand(0xA6); // 0xA6=正常，0xA7=反色

    // 16. 显示开启
    SSD1306_WriteCommand(0xAF);

    // 初始化完成后清屏
    SSD1306_Clear();
}

/**
 * @brief 清屏
 */
void SSD1306_Clear(void)
{
    uint8_t page, col;

    for (page = 0; page < 8; page++) {      // 8 页 (64行 / 8 = 8页)
        SSD1306_SetCursor(0, page);
        for (col = 0; col < 128; col++) {   // 128 列
            SSD1306_WriteData(0x00);        // 写入 0 表示熄灭
        }
    }
}

/**
 * @brief 设置光标位置（页寻址模式）
 * @param x    列地址 (0 ~ 127)
 * @param page 页地址 (0 ~ 7)
 */
void SSD1306_SetCursor(uint8_t x, uint8_t page)
{
    // 限制范围
    if (x > 127)    x = 127;
    if (page > 7)   page = 7;

    // 设置页起始地址: 0xB0 ~ 0xB7
    SSD1306_WriteCommand(0xB0 + page);

    // 设置列地址低 4 位: 0x00 ~ 0x0F
    SSD1306_WriteCommand(0x00 + (x & 0x0F));

    // 设置列地址高 4 位: 0x10 ~ 0x1F
    SSD1306_WriteCommand(0x10 + ((x >> 4) & 0x0F));
}

/**
 * @brief 显示单个 ASCII 字符（5x7 字体，占 6x8 像素）
 * @param ch 待显示字符
 */
void SSD1306_WriteChar(char ch)
{
    uint8_t i;
    uint8_t index;

    // 过滤不可打印字符，统一显示为空格
    if (ch < 32 || ch > 126) {
        ch = ' ';
    }

    index = ch - 32; // 字库从空格(32)开始

    // 写入 5 列字模数据
    for (i = 0; i < 5; i++) {
        SSD1306_WriteData(Font5x7[index][i]);
    }

    // 第 6 列为字间距（空白列）
    SSD1306_WriteData(0x00);
}

/**
 * @brief 显示字符串
 * @param str 待显示字符串（以 '\0' 结尾）
 */
void SSD1306_WriteString(char *str)
{
    if (str == NULL) return;

    while (*str != '\0') {
        SSD1306_WriteChar(*str);
        str++;
    }
}
